## meta-ewaol-hackathon/conf/distro/include/hkt-bsp.inc
```bitbake
require ${HKT_RASPBERRYPI_DYNAMIC_DIR}/conf/machine/hkt-machine-extra-settings.inc
```

## meta-ewaol-hackathon/conf/layer.conf
```bitbake
BBPATH .= ":${LAYERDIR}"
BBFILES += "${LAYERDIR}/recipes-*/*.bb \
            ${LAYERDIR}/recipes-*/*.bbappend \
            ${LAYERDIR}/recipes-*/*/*.bbappend \
"

BBFILE_COLLECTIONS += "ewaol-eclipse-hackathon"
BBFILE_PATTERN_ewaol-eclipse-hackathon = "^${LAYERDIR}/"
BBFILE_PRIORITY_ewaol-eclipse-hackathon = "6"
LAYERSERIES_COMPAT_ewaol-eclipse-hackathon = "kirkstone"
```

## meta-ewaol-hackathon/dynamic-layers/meta-raspberrypi/conf/machine/hkt-machine-extra-settings.inc
```bitbake
HKT_BSP_DYN_MACHINE_EXTRA_REQUIRE ?= ""
HKT_BSP_DYN_MACHINE_EXTRA_REQUIRE:raspberrypi64 = "rpi64-extra-settings.inc"

require ${HKT_BSP_DYN_MACHINE_EXTRA_REQUIRE}
```

## meta-ewaol-hackathon/dynamic-layers/meta-raspberrypi/conf/machine/rpi64-extra-settings.inc
```bitbake
# Ensure Xen is deployed into the wic
do_image_wic[depends] += "xen:do_deploy"

# Install Xen EDKII UEFI firmware
MACHINE_ESSENTIAL_EXTRA_RDEPENDS += "edk2-firmware"
```
